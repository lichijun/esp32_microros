## components/uart_dma/Kconfig
```kconfig
menu "UartDma Configuration"

    orsource "$IDF_PATH/examples/common_components/env_caps/$IDF_TARGET/Kconfig.env_caps"

    config UARTDMA_UART_BAUD_RATE
        int "UART communication speed"
        range 1200 1152000
        default 115200
        help
            UART communication speed for the example.

    config UARTDMA_UART_RXD
        int "UART RXD pin number"
        range ENV_GPIO_RANGE_MIN ENV_GPIO_IN_RANGE_MAX
        default 5
        help
            GPIO number for UART RX pin. See UART documentation for more information
            about available pin numbers for UART.

    config UARTDMA_UART_TXD
        int "UART TXD pin number"
        range ENV_GPIO_RANGE_MIN ENV_GPIO_OUT_RANGE_MAX
        default 4
        help
            GPIO number for UART TX pin. See UART documentation for more information
            about available pin numbers for UART.

endmenu
```

## main/Kconfig.projbuild
```kconfig
menu "Example Configuration"

    orsource "$IDF_PATH/examples/common_components/env_caps/$IDF_TARGET/Kconfig.env_caps"

    config EXAMPLE_TASK_STACK_SIZE
        int "Example task stack size"
        range 1024 16384
        default 3072
        help
            Defines stack size for UART TX and RX tasks. Insufficient stack size can cause crash.

endmenu
```
